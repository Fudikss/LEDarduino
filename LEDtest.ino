#define SCK 13
#define DIN 11
#define LATCH 10
#define TEXTBUFFERLENGTH 40
#define MODULESIZE 4 /* Module Number */
#define SCROLLSPEED 50

#include <SoftwareSerial.h>
#include <LedControl.h>
SoftwareSerial BTSerial(2, 3);
String string = "Test";
String test;/* Input String to Display */
int stringLength;
uint8_t stringBuff[TEXTBUFFERLENGTH][8];
uint8_t displayBuff[MODULESIZE][8]; /* Display Data Buffer */
boolean scrollFlag = false;
int scrollTIme = SCROLLSPEED;
boolean recFlag = false; /* 시리얼 통신 한문장이 수신되면 활성화 */
String recString; /* 시리얼 통신으로 받은 문자열을 저장 */
boolean resetFlag = false; /* LED Matrix 에 표시할 데이터가 변경되야 하는 경우 활성화*/

/* Reference : https://github.com/dhepper/font8x8/blob/master/font8x8_basic.h */
const uint8_t font[128][8] PROGMEM = {
  { 0x00, 0x00, 0x00, 0x00, 0x00, 0x00, 0x00, 0x00}, // U+0000 (nul)
  { 0x00, 0x00, 0x00, 0x00, 0x00, 0x00, 0x00, 0x00}, // U+0001
  { 0x00, 0x00, 0x00, 0x00, 0x00, 0x00, 0x00, 0x00}, // U+0002
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  { 0x00, 0x00, 0x00, 0x00, 0x00, 0x00, 0x00, 0x00} // U+007F
};
void setup() {
  pinMode(SCK, OUTPUT);
  pinMode(DIN, OUTPUT);
  pinMode(LATCH, OUTPUT);
  Serial.begin(9600);
  BTSerial.begin(9600);
  write_Max7219(0x09, 0x00); // Decode Mode - No decode for digits
  write_Max7219(0x0a, 0x01); // Intensity - 1/32
  write_Max7219(0x0b, 0x07); // Scan Limit - All Output Port Enable
  write_Max7219(0x0c, 0x01); // Shutdown - Normal Operation
  write_Max7219(0x0f, 0x00); // Display Test
  delay(60);
  reset_StringBuff();
}

void loop() {
  unsigned long now = millis();
  static unsigned long pastTime;
  if (now - pastTime >= scrollTIme) {
    if (scrollFlag) {
      pastTime = now;
      static int index;
      static int shiftCount;
      if (resetFlag) {
        resetFlag = false;
        index = 0;
        shiftCount = 0;
      }
      for (int i = 0 ; i < 4 ; i++) {
        for (int j = 0 ; j < 8 ; j++) {
          displayBuff[i][j] = (stringBuff[index + i][j] >> shiftCount) | stringBuff[index + i + 1][j] << 8 - shiftCount;
        }
      }
      shiftCount++;
      if (shiftCount == 8) {
        shiftCount = 0;
        index++;
      }
      if (index > stringLength + 5) {
        index = 0;
      }
      if (scrollTIme < 55) {
        write_Max7219(0x0c, 0x00);
        display_Max7219();
        write_Max7219(0x0c, 0x01);
      }
      else {
        display_Max7219();
      }
    }
  }
  if (recFlag) {
    recFlag = false;
    reset_StringBuff();
  }
  while (BTSerial.available()) {
    char myChar = (char)BTSerial.read();
    string += myChar;
    Serial.println("input value:" + string);
    delay(5);

  }

  if (!string.equals("")) {
    Serial.println("input value:" + string);
    serialEvent(string);
  }

}

void write_Max7219(uint8_t address, uint8_t data) {
  digitalWrite(LATCH, LOW);
  for (int i = 1 ; i < 8 ; i++) {
    shiftOut(DIN, SCK, MSBFIRST, address);
    shiftOut(DIN, SCK, MSBFIRST, data);
  }
  digitalWrite(LATCH, HIGH);
}

void display_Max7219() {
  for ( int rowNumber = 1 ; rowNumber < 9 ; rowNumber++) {
    digitalWrite(LATCH, LOW);
    for ( int columnData = 0 ; columnData < MODULESIZE ; columnData++) {
      shiftOut(DIN, SCK, MSBFIRST, rowNumber);
      shiftOut(DIN, SCK, LSBFIRST, displayBuff[columnData][rowNumber - 1]);
    }
    digitalWrite(LATCH, HIGH);
  }
}
void reset_StringBuff() {
  stringLength = string.length();
  for (int i = 0 ; i < TEXTBUFFERLENGTH ; i++) {
    for (int j = 0 ; j < 8 ; j++) {
      stringBuff[i][j] = 0b00;
    }
  }
  if (stringLength > 4) {
    scrollFlag = true;
    for (int i = 5 ; i < stringLength + 5 ; i++) {
      for (int j = 0 ; j < 8 ; j++) {
        stringBuff[i][j] = pgm_read_byte(&(font[string.charAt(i - 5)][j]));
      }
    }
  }
  else {
    scrollFlag = false;
    for (int i = 0 ; i < MODULESIZE ; i++) {
      for (int j = 0 ; j < 8 ; j++) {
        displayBuff[i][j] = pgm_read_byte(&(font[string.charAt(i)][j]));
        display_Max7219();
      }
    }
  }
  string = "";
  resetFlag = true;
}
void serialEvent(String ADName) {
  /*char c = (char)Serial.read();
    if((c != '\n')&&(c != '\r')){
    recString += c;
    }
    if(c == '\n'){
    string = recString;
    recString = "";
    recFlag = true;
    }*/
  String c = ADName;

  /*if (ADName == "ON") {
    lc.shutdown(0, false);
    lc.shutdown(1, false);
    lc.shutdown(2, false);
    lc.shutdown(3, false);
  }
  if (ADName == "OFF") {
    lc.shutdown(0, true);
    lc.shutdown(0, true);
    lc.shutdown(0, true);
    lc.shutdown(0, true);
  }*/


  if (!c.equals("")) {

    recFlag = true;
  }
}
